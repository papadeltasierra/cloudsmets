## esp32/cloudsmets/main/Kconfig.projbuild
```kconfig
menu "CloudSMETS"

    menu "Log output"

        choice CS_LOG_DEFAULT_LEVEL
            bool "Default log verbosity"
            default CS_LOG_DEFAULT_LEVEL_INFO
            help
                Specify how much output to see in logs by default.
                You can set lower verbosity level at runtime using
                esp_log_level_set function.

                By default, this setting limits which log statements
                are compiled into the program. For example, selecting
                "Warning" would mean that changing log level to "Debug"
                at runtime will not be possible. To allow increasing log
                level above the default at runtime, see the next option.

            config CS_LOG_DEFAULT_LEVEL_NONE
                bool "No output"
            config CS_LOG_DEFAULT_LEVEL_ERROR
                bool "Error"
            config CS_LOG_DEFAULT_LEVEL_WARN
                bool "Warning"
            config CS_LOG_DEFAULT_LEVEL_INFO
                bool "Info"
            config CS_LOG_DEFAULT_LEVEL_DEBUG
                bool "Debug"
            config CS_LOG_DEFAULT_LEVEL_VERBOSE
                bool "Verbose"
        endchoice

        config CS_LOG_DEFAULT_LEVEL
            int
            default 0 if CS_LOG_DEFAULT_LEVEL_NONE
            default 1 if CS_LOG_DEFAULT_LEVEL_ERROR
            default 2 if CS_LOG_DEFAULT_LEVEL_WARN
            default 3 if CS_LOG_DEFAULT_LEVEL_INFO
            default 4 if CS_LOG_DEFAULT_LEVEL_DEBUG
            default 5 if CS_LOG_DEFAULT_LEVEL_VERBOSE

        choice CS_LOG_MAXIMUM_LEVEL
            bool "Maximum log verbosity"
            default CS_LOG_MAXIMUM_EQUALS_DEFAULT
            help
                This config option sets the highest log verbosity that it's possible to select
                at runtime by calling esp_log_level_set(). This level may be higher than
                the default verbosity level which is set when the app starts up.

                This can be used enable debugging output only at a critical point, for a particular
                tag, or to minimize startup time but then enable more logs once the firmware has
                loaded.

                Note that increasing the maximum available log level will increase the firmware
                binary size.

                This option only applies to logging from the app, the bootloader log level is
                fixed at compile time to the separate "Bootloader log verbosity" setting.

            config CS_LOG_MAXIMUM_EQUALS_DEFAULT
                bool "Same as default"
            config CS_LOG_MAXIMUM_LEVEL_ERROR
                bool "Error"
                depends on CS_LOG_DEFAULT_LEVEL < 1
            config CS_LOG_MAXIMUM_LEVEL_WARN
                bool "Warning"
                depends on CS_LOG_DEFAULT_LEVEL < 2
            config CS_LOG_MAXIMUM_LEVEL_INFO
                bool "Info"
                depends on CS_LOG_DEFAULT_LEVEL < 3
            config CS_LOG_MAXIMUM_LEVEL_DEBUG
                bool "Debug"
                depends on CS_LOG_DEFAULT_LEVEL < 4
            config CS_LOG_MAXIMUM_LEVEL_VERBOSE
                bool "Verbose"
                depends on CS_LOG_DEFAULT_LEVEL < 5
        endchoice

        config CS_LOG_MAXIMUM_LEVEL
            int
            default CS_LOG_DEFAULT_LEVEL if CS_LOG_MAXIMUM_EQUALS_DEFAULT
            default 0 if CS_LOG_MAXIMUM_LEVEL_NONE
            default 1 if CS_LOG_MAXIMUM_LEVEL_ERROR
            default 2 if CS_LOG_MAXIMUM_LEVEL_WARN
            default 3 if CS_LOG_MAXIMUM_LEVEL_INFO
            default 4 if CS_LOG_MAXIMUM_LEVEL_DEBUG
            default 5 if CS_LOG_MAXIMUM_LEVEL_VERBOSE


    endmenu

    menu "Tasks"

        config CS_TASK_QUEUE_SIZE
            int "Event loop queue size"
            range 2 20
            default 5
            help
                Number of events that can be queued per event loop.

        config CS_TASK_PRIORITY_DEFAULT
            int "Task priority (0 lowest)"
            range 0 25
            default 10
            help
                Default priority of CloudSMETS tasks; highest tasks are run first.

        config CS_TASK_STACK_SIZE
            int "Stack size (in bytes) for each task"
            range 128 4096
            default 128
            help
                Stack size for each cloudSMETS task.

        config CS_TASK_TICKS_TO_WAIT
            int "Time to wait (in 1/10ths of a second) when posting an event."
            range 0 20
            default 10
            help
                Time to wait to post an event if the event loop queue is already full.

    endmenu

    menu "Wifi"

        # TODO: Maybe clean this up?  Are these correct?  What about the defaults file?

        config CS_WIFI_AP_CHANNEL
            int "WiFi Channel"
            range 1 13
            default 6
            help
                WiFi channel (network channel) for the example to use.

        config CS_WIFI_AP_SSID
            string "SoftAP (peer-to-peer) WiFi SSID"
            default "CloudSMETS"
            help
                WiFi SSID for the SoftAP (peer-to-peer) WiFi AP.

        config CS_WIFI_AP_PWD
            string "SoftAP (peer-to-peer) WiFi password"
            default "CloudSMETS"
            help
                WiFi password for the SoftAP (peer-to-peer) WiFi AP.

        config CS_WIFI_AP_CHANNEL
            int "WiFi Channel"
            range 1 13
            default 6
            help
                WiFi channel (network channel) for the example to use.

        config CS_WIFI_STA_MAX_CONN
            int "Maximal STA connections"
            default 4
            help
                Max number of the STA connects to AP.

        config CS_WIFI_AP_MAX_CONN
            int "Maximal AP connections"
            default 4
            help
                Max number of the connects to SoftAP.

        config CS_WIFI_STA_MAXIMUM_RETRY
            int "Maximum STA connect retries each cycle"
            default 5
            help
                Maximum STA connect retries each cycle.

        config CS_WIFI_STA_RETRY_INTERVAL
            int "Retry interval (seconds) between STA connect retries."
            default 60
            help
                Retry interval (seconds) between STA connect retries.

    endmenu

    menu "Web server"

        config CS_WEB_LISTEN_PORT
            int "Port on which web server listens"
            range 80 65534
            default 8000
            help
                Port on which the web server listens.

    endmenu

    menu "OTA"

        config CS_OTA_ENABLED
            int "OTA enabled (recommend on!)"
            range 0 1
            default 1
            help
                Whether OTA functionality is enabled.

        config CS_OTA_DEV_IMAGES
            int "Development images permitted"
            range 0 1
            default 0
            help
                Whether OTA should consider developmemt images; recommend 'No' (0).

        config CS_OTA_REVISION_SERVER_URL
            string "OTA latest-revision server URL"
            default "https://cloudsmets.azurewebsites.net/api/LatestRevision"
            help
                Server that identifies the latest suitable CloudSMETS version.

        config CS_OTA_IMAGE_SERVER_URL
            string "OTA image server URL"
            default "https://cloudsmets.blob.core.windows.net/cloudsmets/"
            help
                Server from which OTA images are downloaded.

        config CS_OTA_ACCEPT
            int "OTA acceptence period (minutes)"
            range 1 720
            default 60
            help
                Time, in minutes, that an image must run before being accepted.

    endmenu

endmenu
```

## esp32/uartrelay/main/Kconfig.projbuild
```kconfig
menu "UART Relay Configuration"

    orsource "$IDF_PATH/examples/common_components/env_caps/$IDF_TARGET/Kconfig.env_caps"

    config ENV_UART_GPIO_RANGE_MAX
        int
        default 21
        # GPIOs 20/21 are always used by UART in examples

    config EXAMPLE_UART0_PORT_NUM
        int "UART port A number"
        range 0 2 if IDF_TARGET_ESP32 || IDF_TARGET_ESP32S3
        default 1 if IDF_TARGET_ESP32 || IDF_TARGET_ESP32S3
        range 0 1 if IDF_TARGET_ESP32S2 || IDF_TARGET_ESP32C3 || IDF_TARGET_ESP32C2 || IDF_TARGET_ESP32H2
        default 0 if IDF_TARGET_ESP32S2 || IDF_TARGET_ESP32C3 || IDF_TARGET_ESP32C2 || IDF_TARGET_ESP32H2
        help
            UART communication port number for the example.
            See UART documentation for available port numbers.

    config EXAMPLE_UART1_PORT_NUM
        int "UART port B number"
        range 0 2 if IDF_TARGET_ESP32 || IDF_TARGET_ESP32S3
        default 2 if IDF_TARGET_ESP32 || IDF_TARGET_ESP32S3
        range 0 1 if IDF_TARGET_ESP32S2 || IDF_TARGET_ESP32C3 || IDF_TARGET_ESP32C2 || IDF_TARGET_ESP32H2
        default 1 if IDF_TARGET_ESP32S2 || IDF_TARGET_ESP32C3 || IDF_TARGET_ESP32C2 || IDF_TARGET_ESP32H2
        help
            UART communication port number for the example.
            See UART documentation for available port numbers.

    config EXAMPLE_UART_BAUD_RATE
        int "UART communication speed"
        range 1200 115200
        default 115200
        help
            UART communication speed for Modbus example.

    config EXAMPLE_UART0_RXD
        int "UART RXD A pin number"
        range ENV_GPIO_RANGE_MIN ENV_UART_GPIO_RANGE_MAX
        default 20
        help
            GPIO number for UART A RX pin. See UART documentation for more information
            about available pin numbers for UART.

    config EXAMPLE_UART0_TXD
        int "UART TXD A pin number"
        range ENV_GPIO_RANGE_MIN ENV_UART_GPIO_RANGE_MAX
        default 21
        help
            GPIO number for UART A TX pin. See UART documentation for more information
            about available pin numbers for UART.

    config EXAMPLE_UART1_RXD
        int "UART RXD B pin number"
        range ENV_GPIO_RANGE_MIN ENV_UART_GPIO_RANGE_MAX
        default 19
        help
            GPIO number for UART B RX pin. See UART documentation for more information
            about available pin numbers for UART.

    config EXAMPLE_UART1_TXD
        int "UART TXD B pin number"
        range ENV_GPIO_RANGE_MIN ENV_UART_GPIO_RANGE_MAX
        default 18
        help
            GPIO number for UART B TX pin. See UART documentation for more information
            about available pin numbers for UART.

    config EXAMPLE_TASK_STACK_SIZE
        int "UART echo example task stack size"
        range 1024 16384
        default 4096
        help
            Defines stack size for UART echo example. Insufficient stack size can cause crash.

endmenu
```
